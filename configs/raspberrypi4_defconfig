## configs/raspberrypi4_defconfig
```kconfig
BR2_arm=y
BR2_cortex_a72=y
BR2_ARM_FPU_NEON_VFPV4=y

# patches
BR2_GLOBAL_PATCH_DIR="board/raspberrypi/patches"
BR2_DOWNLOAD_FORCE_CHECK_HASHES=y

BR2_TOOLCHAIN_BUILDROOT_CXX=y

BR2_SYSTEM_DHCP="eth0"

# Linux headers same as kernel, a 6.1 series
BR2_PACKAGE_HOST_LINUX_HEADERS_CUSTOM_6_1=y

BR2_LINUX_KERNEL=y
BR2_LINUX_KERNEL_CUSTOM_TARBALL=y
BR2_LINUX_KERNEL_CUSTOM_TARBALL_LOCATION="$(call github,raspberrypi,linux,17f135b742c4edb340afb365873c3a574f7e16cb)/linux-17f135b742c4edb340afb365873c3a574f7e16cb.tar.gz"
BR2_LINUX_KERNEL_DEFCONFIG="bcm2711"

# Build the DTB from the kernel sources
BR2_LINUX_KERNEL_DTS_SUPPORT=y
BR2_LINUX_KERNEL_INTREE_DTS_NAME="bcm2711-rpi-4-b"

BR2_LINUX_KERNEL_NEEDS_HOST_OPENSSL=y

BR2_PACKAGE_RPI_FIRMWARE=y
BR2_PACKAGE_RPI_FIRMWARE_VARIANT_PI4=y
BR2_PACKAGE_RPI_FIRMWARE_CONFIG_FILE="board/raspberrypi4/config_4.txt"

# Required tools to create the SD image
BR2_PACKAGE_HOST_DOSFSTOOLS=y
BR2_PACKAGE_HOST_GENIMAGE=y
BR2_PACKAGE_HOST_MTOOLS=y

# Filesystem / image
BR2_TARGET_ROOTFS_EXT2=y
BR2_TARGET_ROOTFS_EXT2_4=y
BR2_TARGET_ROOTFS_EXT2_SIZE="120M"
# BR2_TARGET_ROOTFS_TAR is not set
BR2_ROOTFS_POST_BUILD_SCRIPT="board/raspberrypi4/post-build.sh"
BR2_ROOTFS_POST_IMAGE_SCRIPT="board/raspberrypi4/post-image.sh"

# Enable compressed kernel module support
BR2_PACKAGE_BUSYBOX_SHOW_OTHERS=y
BR2_PACKAGE_KMOD_TOOLS=y
BR2_PACKAGE_XZ=y
BR2_PACKAGE_KMOD=y
BR2_PACKAGE_HOST_KMOD_XZ=y

# Fragment files
BR2_LINUX_KERNEL_CONFIG_FRAGMENT_FILES="/home/gabriel/Documents/Projects/buildroot.rockchip.ext/package/example-module-overlay/module-overlay-rk3308/kernel.fragment"

# Extra DTBs
BR2_LINUX_KERNEL_DTB_OVERLAY_SUPPORT=y

# Custom packages
BR2_PACKAGE_FPGA_SOUNDCARD=y

# Enable debugging tools
BR2_PACKAGE_HOST_GDB=y
BR2_PACKAGE_GDB=y
BR2_PACKAGE_GDB_SERVER=y
BR2_PACKAGE_RPI_FIRMWARE_INSTALL_VCDBG=y

# Enabling some ssh utilities
BR2_PACKAGE_DROPBEAR=y

# Generic configs
BR2_TARGET_GENERIC_ROOT_PASSWD="pi"
BR2_PACKAGE_I2C_TOOLS=y
BR2_PACKAGE_MDNSD=y

# Alsa things
BR2_PACKAGE_ALSA_UTILS=y
BR2_PACKAGE_ALSA_UTILS_ALSAMIXER=y
BR2_PACKAGE_ALSA_UTILS_AMIXER=y
BR2_PACKAGE_ALSA_UTILS_APLAY=y
BR2_PACKAGE_ALSA_UTILS_ALSACTL=y
```

## package/custom-uart/Config.in
```kconfig
config BR2_PACKAGE_CUSTOM_UART
        bool "custom-uart"
        depends on BR2_LINUX_KERNEL
        help
          Custom uart driver making use of the MMIO
```

## package/fpga-soundcard/Config.in
```kconfig
config BR2_PACKAGE_FPGA_SOUNDCARD
	bool "fpga-soundcard"
	depends on BR2_LINUX_KERNEL
	help
	  FPGA soundcard controlled by I2C and its respective device tree overlay
```

## package/fpga-soundcard/module-fpga-soundcard/Kconfig
```kconfig
config SND_SOC_FPGA_SOUNDCARD
        tristate "RK33xx platform machine driver for a fpga soundcard controlled by I2C"
        default n
        help
          ALSA machine driver for a dummy soundcard
```
